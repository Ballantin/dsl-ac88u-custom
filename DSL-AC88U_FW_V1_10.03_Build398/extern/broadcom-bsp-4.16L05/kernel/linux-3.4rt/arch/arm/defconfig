## DSL-AC88U_FW_V1_10.03_Build398/extern/broadcom-bsp-4.16L05/kernel/linux-3.4rt/drivers/switch/Kconfig
```kconfig
if BCM_KF_ANDROID
menuconfig SWITCH
	tristate "Switch class support"
	depends on BCM_KF_ANDROID && BCM_ANDROID
	help
	  Say Y here to enable switch class support. This allows
	  monitoring switches by userspace via sysfs and uevent.

if SWITCH

config SWITCH_GPIO
	tristate "GPIO Swith support"
	depends on GENERIC_GPIO
	depends on BCM_KF_ANDROID && BCM_ANDROID
	help
	  Say Y here to enable GPIO based switch support.

endif # SWITCH
endif
```

## DSL-AC88U_FW_V1_10.03_Build398/package/pure-ftpd/Config.in
```kconfig
# pure-ftpd configuration

menu "Configuration"
  depends on PACKAGE_pure-ftpd || PACKAGE_pure-ftpd-tls
  
config PACKAGE_pure-ftpd-with-ARC_ISO_SYMLINK
   bool "ARCADYAN isolate symblic out of usb storage"
   default y
   	
		menu "mount point"
			depends PACKAGE_pure-ftpd-with-ARC_ISO_SYMLINK

			config PACKAGE_pure-ftpd-usb-mountpoint-tmp-media
			bool "/tmp/mnt"
			default y
			
			config PACKAGE_pure-ftpd-usb-mountpoint-tmp-usbMountNameReversal
			bool "/tmp/usbMountNameReversal"
			default n

		endmenu

endmenu
```

## DSL-AC88U_FW_V1_10.03_Build398/package/tuxera/Config.in
```kconfig
# Tuxera package config

menu "Configuration"
	depends on PACKAGE_kmod-tuxera

config tuxera_EXFAT
	bool "Support Tuxera exfat"
	default n
	help

config tuxera_FAT
	bool "Support Tuxera fat"
	default n
	help
	
config tuxera_HFSPLUS
	bool "Support Tuxera HFS plus"
	default n
	help
	
config tuxera_NTFS
	bool "Support Tuxera NTFS"
	default n
	help

endmenu
```
